/* Copyright (c) 2013, The Linux Foundation. All rights reserved.
 *
 * This program is free software; you can redistribute it and/or modify
 * it under the terms of the GNU General Public License version 2 and
 * only version 2 as published by the Free Software Foundation.
 *
 * This program is distributed in the hope that it will be useful,
 * but WITHOUT ANY WARRANTY; without even the implied warranty of
 * MERCHANTABILITY or FITNESS FOR A PARTICULAR PURPOSE.  See the
 * GNU General Public License for more details.
 */

/*---------------------------------------------------------------------------
 * This file is autogenerated file using gcdb parser. Please do not edit it.
 * Update input XML file to add a new entry or update variable in this file
 * VERSION = "1.0"
 *---------------------------------------------------------------------------*/
&mdss_mdp {
	dsi_hx8389b_qhd_vid: qcom,mdss_dsi_hx8389b_qhd_video {
		qcom,mdss-dsi-panel-name = "HX8389b YASSY QHD video mode dsi panel";
		qcom,mdss-dsi-panel-controller = <&mdss_dsi0>;
		qcom,mdss-dsi-panel-type = "dsi_video_mode";
		qcom,mdss-dsi-panel-destination = "display_1";
		qcom,mdss-dsi-panel-framerate = <60>;
		qcom,mdss-dsi-virtual-channel-id = <0>;
		qcom,mdss-dsi-stream = <0>;
		qcom,mdss-dsi-panel-width = <540>;
		qcom,mdss-dsi-panel-height = <960>;
		qcom,mdss-dsi-h-front-porch = <60>;
		qcom,mdss-dsi-h-back-porch = <39>;
		qcom,mdss-dsi-h-pulse-width = <39>;
		qcom,mdss-dsi-h-sync-skew = <0>;
		qcom,mdss-dsi-v-back-porch = <5>;
		qcom,mdss-dsi-v-front-porch = <9>;
		qcom,mdss-dsi-v-pulse-width = <2>;
		qcom,mdss-dsi-h-left-border = <0>;
		qcom,mdss-dsi-h-right-border = <0>;
		qcom,mdss-dsi-v-top-border = <0>;
		qcom,mdss-dsi-v-bottom-border = <0>;
		qcom,mdss-dsi-bpp = <24>;
		qcom,mdss-dsi-underflow-color = <0xff>;
		qcom,mdss-dsi-border-color = <0>;
		qcom,mdss-dsi-on-command = [
 				39 01 00 00 00 00 04
 					B9 FF 83 89
 				39 01 00 00 00 00 03
					BA 41 93
				39 01 00 00 00 00 14
					B1 00 00 07
					EB A5 10 11
					D4 F4 27 2F
					3F 3F 42 01
					5A F5 20 00
				39 01 00 00 00 00 08
					B2 00 00 78
					04 07 3F F0
				39 01 00 00 00 00 04
					B7 00 00 59
				39 01 00 00 00 00 20
					B4 00 02 00 
					32 10 03 32 
					13 C6 32 10 
					00 17 09 48 
					06 13 02 48
					1E 58 5C 0A 
					00 40 00 40 
					14 46 50 0A
				39 01 00 00 00 00 34
					D5 00 00 00 
					00 57 00 00 
					00 01 08 88 
					88 21 64 75 
					32 10 54 88
					88 88 88 88 
					88 88 88 88 
					88 88 88 88 
					45 46 57 01 
					23 12 88 88
					88 88 88 88 
					88 88 88 88 
					88 02 02 00
				39 01 00 00 00 00 24
					E0 00 0F 19 
					32 38 3F 23 
					41 0B 0E 10 
					14 17 14 15 
					11 17 00 0F
					19 32 38 3F 
					23 41 0B 0E 
					10 14 17 14 
					15 11 17 00 
				39 01 00 00 00 00 80
			   		C1 01 00 08 
			   		10 1A 21 29 
			   		31 38 40 48 
			   		50 58 60 68 
			  	 	70 77 7F 87
			  		8F 97 9F A7 
			   		AF B7 C0 C8 
			   		CE D6 DF E6 
			   		F2 FA FF 1C 
			   		31 97 E7 AB
			   		82 2E 9F 80 
			   		00 08 10 1A 
			   		21 29 31 38 
			   		40 48 50 58 
			   		60 68 70 77
			   		7A 81 8A 91 
			   		9A A1 AA B1 
			   		BA C1 CA D1 
			   		DA E1 EA F3 
			   		F6 1C 31 97
			   		E7 AB 82 2E 
			   		9F 80 00 08 
			   		10 1A 21 29 
			   		31 38 40 48 
			   		50 58 60 68
			   		70 77 7A 81 
			   		8A 91 9A A1
			   		AA B1 BA C1 
			   		CA D1 DA E1 
			   		EA F3 F6 1C
			   		31 97 E7 AB 
			   		82 2E 9F 80 
				39 01 00 00 00 00 02
					CC 02
				39 01 00 00 00 00 05
					B6 00 7E 00 7E
				39 01 00 00 00 00 03
					C0 43 17
				39 01 00 00 00 00 03
					C9 0F 05
				39 01 00 00 00 00 02
					36 00
				39 01 00 00 00 00 06
					B6 00 77 00 77 00
				39 01 00 00 00 00 02
					35 00
				15 01 00 00 00 00 02
					51 1F
				39 01 00 00 00 00 02
					53 2C
				39 01 00 00 00 00 02
					55 00
 				05 01 00 00 96 00 02
 					11 00
 				05 01 00 00 96 00 02
					29 00];
		qcom,mdss-dsi-off-command = [05 01 00 00 32 00 02 28 00
					05 01 00 00 78 00 02 10 00];
		qcom,mdss-dsi-on-command-state = "dsi_lp_mode";
		qcom,mdss-dsi-off-command-state = "dsi_lp_mode";
		qcom,mdss-dsi-h-sync-pulse = <1>;
		qcom,mdss-dsi-traffic-mode = "burst_mode";
		qcom,mdss-dsi-lane-map = "lane_map_3012";
		qcom,mdss-dsi-hfp-power-mode;
		qcom,mdss-dsi-hsa-power-mode;
		qcom,mdss-dsi-hbp-power-mode;
		qcom,mdss-dsi-bllp-eof-power-mode;
		qcom,mdss-dsi-bllp-power-mode;
		qcom,mdss-dsi-lane-0-state;
		qcom,mdss-dsi-lane-1-state;
		qcom,mdss-dsi-panel-timings = [87 1E 14 00 44 4B 19 21 22 03 04 00];
		qcom,mdss-dsi-t-clk-post = <0x04>;
		qcom,mdss-dsi-t-clk-pre = <0x1b>;
		qcom,mdss-dsi-bl-min-level = <1>;
		qcom,mdss-dsi-bl-max-level = <255>;
		qcom,mdss-dsi-dma-trigger = "trigger_sw";
		qcom,mdss-dsi-mdp-trigger = "none";
		qcom,mdss-dsi-bl-pmic-control-type = "bl_ctrl_wled";
		qcom,mdss-dsi-reset-sequence = <1 20>, <0 2>, <1 20>;
	};
};
