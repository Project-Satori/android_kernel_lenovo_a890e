/* Copyright (c) 2013, The Linux Foundation. All rights reserved.
 *
 * This program is free software; you can redistribute it and/or modify
 * it under the terms of the GNU General Public License version 2 and
 * only version 2 as published by the Free Software Foundation.
 *
 * This program is distributed in the hope that it will be useful,
 * but WITHOUT ANY WARRANTY; without even the implied warranty of
 * MERCHANTABILITY or FITNESS FOR A PARTICULAR PURPOSE.  See the
 * GNU General Public License for more details.
 */

/*---------------------------------------------------------------------------
 * This file is autogenerated file using gcdb parser. Please do not edit it.
 * Update input XML file to add a new entry or update variable in this file
 * VERSION = "1.0"
 *---------------------------------------------------------------------------*/
&mdss_mdp {
	dsi_hx8379a_wvga_vid: qcom,mdss_dsi_nt35517_qhd_video {
		qcom,mdss-dsi-panel-name = "NT35517 BOE QHD video mode dsi panel";
		qcom,mdss-dsi-panel-controller = <&mdss_dsi0>;
		qcom,mdss-dsi-panel-type = "dsi_video_mode";
		qcom,mdss-dsi-panel-destination = "display_1";
		qcom,mdss-dsi-panel-framerate = <60>;
		qcom,mdss-dsi-virtual-channel-id = <0>;
		qcom,mdss-dsi-stream = <0>;
		qcom,mdss-dsi-panel-width = <540>;
		qcom,mdss-dsi-panel-height = <960>;
		qcom,mdss-dsi-h-front-porch = <100>;
		qcom,mdss-dsi-h-back-porch = <94>;
		qcom,mdss-dsi-h-pulse-width = <40>;
		qcom,mdss-dsi-h-sync-skew = <0>;
		qcom,mdss-dsi-v-back-porch = <4>;
		qcom,mdss-dsi-v-front-porch = <6>;
		qcom,mdss-dsi-v-pulse-width = <6>;
		qcom,mdss-dsi-h-left-border = <0>;
		qcom,mdss-dsi-h-right-border = <0>;
		qcom,mdss-dsi-v-top-border = <0>;
		qcom,mdss-dsi-v-bottom-border = <0>;
		qcom,mdss-dsi-bpp = <24>;
		qcom,mdss-dsi-underflow-color = <0xff>;
		qcom,mdss-dsi-border-color = <0>;
		qcom,mdss-dsi-on-command = [
					39 01 00 00 00 00 06
						F0 55 AA 52 08 00
					15 01 00 00 00 00 02
						BC 00
					39 01 00 00 00 00 04
						CC 03 00 00
					39 01 00 00 00 00 06
						B0 00 0C 40 3C 3C
					39 01 00 00 00 00 03
						B1 FC 00
					39 01 00 00 00 00 03
						E0 01 01
					15 01 00 00 00 00 02
						B3 80
					15 01 00 00 00 00 02
						B6 08
					39 01 00 00 00 00 03
						B7 00 00
					15 01 00 00 00 00 02
						BA 01
					39 01 00 00 00 00 06
						BD 01 41 10 37 01
					39 01 00 00 00 00 06
						F0 55 AA 52 08 01
					15 01 00 00 00 00 02
						C0 C2
					15 01 00 00 00 00 02
						C2 20
					39 01 00 00 00 00 04
						B0 0A 0A 0A
					39 01 00 00 00 00 04
						B6 43 43 43
					39 01 00 00 00 00 04
						B1 0A 0A 0A
					39 01 00 00 00 00 04
						B7 23 23 23
					39 01 00 00 00 00 04
						B2 03 03 03
					39 01 00 00 00 00 04
						B8 33 33 33
					39 01 00 00 00 00 04
						B3 0E 0E 0E
					39 01 00 00 00 00 04
						B9 33 33 33
					39 01 00 00 00 00 04
						B4 08 08 08
					39 01 00 00 00 00 04
						BA 33 33 33
					39 01 00 00 00 00 04
						B5 57 57 57
					39 01 00 00 00 00 04
						BC 00 70 00
					39 01 00 00 00 00 04
						BD 00 70 00
					15 01 00 00 00 00 02
						BE 45
					15 01 00 00 00 00 02
					  	BF 40
					39 01 00 00 00 00 11
					  D1 00 20 00
					  32 00 4F 00
					  67 00 7B 00
					  9E 00 BA 00
					  E9
					39 01 00 00 00 00 11
					  D2 01 0F 01
					  4B 01 7A 01
					  C4 01 FF 02
					  01 02 39 02
					  74
					39 01 00 00 00 00 11
					  D3 02 9B 02
					  D4 02 F9 03
					  2F 03 4F 03
					  7D 03 92 03
					  B7
					39 01 00 00 00 00 05
					  D4 03 D1 03 FF
					39 01 00 00 00 00 11
					  D5 00 20 00
					  32 00 4F 00
					  67 00 7B 00
					  9E 00 BA 00
					  E9
					39 01 00 00 00 00 11
					  D6 01 0F 01
					  4B 01 7A 01
					  C4 01 FF 02
					  01 02 39 02
					  74
					39 01 00 00 00 00 11
					  D7 02 9B 02
					  D4 02 F9 03
					  2F 03 4F 03
					  7D 03 92 03
					  B7
					39 01 00 00 00 00 05
					  D8 03 D1 03 FF
					39 01 00 00 00 00 11
					  D9 00 20 00
					  32 00 4F 00
					  67 00 7B 00
					  9E 00 BA 00
					  E9
					39 01 00 00 00 00 11
					  DD 01 0F 01
					  4B 01 7A 01
					  C4 01 FF 02
					  01 02 39 02
					  74
					39 01 00 00 00 00 11
					  DE 02 9B 02
					  D4 02 F9 03
					  2F 03 4F 03
					  7D 03 92 03
					  B7
					39 01 00 00 00 00 05
					  DF 03 D1 03 FF
					39 01 00 00 00 00 11
					  E0 00 20 00
					  32 00 4F 00
					  67 00 7B 00
					  9E 00 BA 00
					  E9
					39 01 00 00 00 00 11
					  E1 01 0F 01
					  4B 01 7A 01
					  C4 01 FF 02
					  01 02 39 02
					  74
					39 01 00 00 00 00 11
					  E2 02 9B 02
					  D4 02 F9 03
					  2F 03 4F 03
					  7D 03 92 03
					  B7
					39 01 00 00 00 00 05
					  E3 03 D1 03 FF
					39 01 00 00 00 00 11
					  E4 00 20 00
					  32 00 4F 00
					  67 00 7B 00
					  9E 00 BA 00
					  E9
					39 01 00 00 00 00 11
					  E5 01 0F 01
					  4B 01 7A 01
					  C4 01 FF 02
					  01 02 39 02
					  74
					39 01 00 00 00 00 11
					  E6 02 9B 02
					  D4 02 F9 03
					  2F 03 4F 03
					  7D 03 92 03
					  B7
					39 01 00 00 00 00 05
					  E7 03 D1 03 FF
					39 01 00 00 00 00 11
					  E8 00 20 00
					  32 00 4F 00
					  67 00 7B 00
					  9E 00 BA 00
					  E9
					39 01 00 00 00 00 11
					  E9 01 0F 01
					  4B 01 7A 01
					  C4 01 FF 02
					  01 02 39 02
					  74
					39 01 00 00 00 00 11
					  EA 02 9B 02
					  D4 02 F9 03
					  2F 03 4F 03
					  7D 03 92 03
					  B7
					39 01 00 00 00 00 05
					  EB 03 D1 03 FF
					39 01 00 00 00 00 05
						FF AA 55 25 01
					15 01 00 00 00 00 02
					  6F 0B
					39 01 00 00 00 00 05
						F4 12 13 56 13
					15 01 00 00 00 00 02
					  35 00
					15 01 00 00 00 00 02
					  51 1F
					15 01 00 00 00 00 02
					  53 2C
					15 01 00 00 00 00 02
					  55 00
					05 01 00 00 78 00 02
						11 00
					05 01 00 00 10 00 02
						29 00
					05 01 00 00 10 00 02
						2C 00
			];
		qcom,mdss-dsi-off-command = [05 01 00 00 32 00 02 28 00
					05 01 00 00 78 00 02 10 00];
		qcom,mdss-dsi-on-command-state = "dsi_lp_mode";
		qcom,mdss-dsi-off-command-state = "dsi_lp_mode";
		qcom,mdss-dsi-h-sync-pulse = <1>;
		qcom,mdss-dsi-traffic-mode = "burst_mode";
		qcom,mdss-dsi-lane-map = "lane_map_3012";
		qcom,mdss-dsi-hfp-power-mode;
		qcom,mdss-dsi-hsa-power-mode;
		qcom,mdss-dsi-hbp-power-mode;
		qcom,mdss-dsi-bllp-eof-power-mode;
		qcom,mdss-dsi-bllp-power-mode;
		qcom,mdss-dsi-lane-0-state;
		qcom,mdss-dsi-lane-1-state;
		qcom,mdss-dsi-panel-timings = [78 1B 11 00 3E 43 16 1E 1D 03 04 00];
		qcom,mdss-dsi-t-clk-post = <0x04>;
		qcom,mdss-dsi-t-clk-pre = <0x1b>;
		qcom,mdss-dsi-bl-min-level = <1>;
		qcom,mdss-dsi-bl-max-level = <255>;
		qcom,mdss-dsi-dma-trigger = "trigger_sw";
		qcom,mdss-dsi-mdp-trigger = "none";
		qcom,mdss-dsi-bl-pmic-control-type = "bl_ctrl_wled";
		qcom,mdss-dsi-reset-sequence = <1 20>, <0 2>, <1 20>;

	};
};
